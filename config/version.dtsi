#define VERSION_MACRO
macro_ver: macro_ver {
compatible = "zmk,behavior-macro";
label = "macro_ver";
#binding-cells = <0>;
bindings = <&kp N2>, <&kp N0>, <&kp N2>, <&kp N4>, <&kp N1>, <&kp N1>, <&kp N0>, <&kp N3>, <&kp MINUS>, <&kp V>, <&kp N3>, <&kp DOT>, <&kp N0>, <&kp MINUS>, <&kp N7>, <&kp D>, <&kp N5>, <&kp D>, <&kp C>, <&kp D>, <&kp N7>, <&kp RET>;
};
